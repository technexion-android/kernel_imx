## Kconfig.ext
```kconfig
# SPDX-License-Identifier: GPL-2.0
# This file is intentionally empty. It's used as a placeholder for when
# KCONFIG_EXT_PREFIX isn't defined.
source "../qcacld-2.0/Kconfig"
```
