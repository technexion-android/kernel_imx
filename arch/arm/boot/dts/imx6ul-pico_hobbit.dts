/*
 * Copyright 2016 Technexion Ltd.
 *
 * Author: Richard Hu <richard.hu@technexion.com>
 *	   Tapani Utriainen <tapani@technexion.com>
 *
 * This program is free software; you can redistribute it and/or modify
 * it under the terms of the GNU General Public License version 2 as
 * published by the Free Software Foundation.
 *
 */

/dts-v1/;

#include <dt-bindings/input/input.h>
#include "imx6ul.dtsi"
#include "imx6ul-pico.dtsi"
#include "baseboard_pico_hobbit.dtsi"

/ {
	model = "TechNexion PICO-IMX6UL and HOBBIT baseboard";
	compatible = "fsl,imx6ul-pico", "fsl,imx6ul";
};
