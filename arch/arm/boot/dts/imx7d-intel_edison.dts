/*
 * Copyright 2016 Technexion Ltd.
 *
 * Author: Tapani Utriainen <tapani@technexion.com>
 *	   Richard Hu <richard.hu@technexion.com>
 *
 * This program is free software; you can redistribute it and/or modify
 * it under the terms of the GNU General Public License version 2 as
 * published by the Free Software Foundation.
 *
 */
/dts-v1/;

#include <dt-bindings/interrupt-controller/irq.h>
#include "imx7d.dtsi"
#include "imx7d-pico_edison.dtsi"
#include "baseboard_intel_edison.dtsi"
/ {
	model = "TechNexion PICO-IMX7D and Intel Edison baseboard";
	compatible = "fsl,pico-cf-imx7d", "fsl,imx7d";
};
