/*
 * Copyright 2016 Technexion Ltd.
 *
 * Author: Tapani Utriainen <tapani@technexion.com>
 *	   Richard Hu <richard.hu@technexion.com>
 *
 * This program is free software; you can redistribute it and/or modify
 * it under the terms of the GNU General Public License version 2 as
 * published by the Free Software Foundation.
 *
 */
/dts-v1/;

#include <dt-bindings/interrupt-controller/irq.h>
#include "imx7d.dtsi"
#include "imx7d-edm1.dtsi"
#include "baseboard_edm1_fairy.dtsi"

/ {
	model = "Technexion EDM1-IMX7 Dual/Solo with Goblin baseboard";
	compatible = "fsl,imx7d-edm1", "fsl,imx7d";
};

&epdc {
	status = "disabled";
};

