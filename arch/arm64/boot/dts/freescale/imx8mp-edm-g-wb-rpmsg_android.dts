// SPDX-License-Identifier: (GPL-2.0+ OR MIT)
/*
 * Copyright 2020 Technexion Ltd.
 *
 * Author: Richard Hu <richard.hu@technexion.com>
 *
 */

/dts-v1/;

#include "imx8mp-edm-g-wb-rpmsg.dts"
#include "imx8mp-android.dtsi"
#include "tn_imx-android.dtsi"

/ {
	model = "[ANDROID] TechNexion EDM-G-IMX8MP with WB baseboard & RPMSG";
};

&vpu_v4l2 {
	status = "okay";
};
