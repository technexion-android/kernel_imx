// SPDX-License-Identifier: (GPL-2.0+ OR MIT)
/*
 * Copyright 2024 Technexion Ltd.
 *
 * Author: Tifa Chen <tifa.chen@technexion.com>
 *
 */

/dts-v1/;

#include "imx8mp-tep-rpmsg.dts"
#include "imx8mp-android.dtsi"

/ {
	model = "[ANDROID] TechNexion TEP-IMX8MP board & RPMSG";
};
