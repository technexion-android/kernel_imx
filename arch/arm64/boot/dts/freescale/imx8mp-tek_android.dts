// SPDX-License-Identifier: (GPL-2.0+ OR MIT)
/*
 * Copyright 2024 Technexion Ltd.
 *
 * Author: Tifa Chen <tifa.chen@technexion.com>
 *
 */

/dts-v1/;

#include "imx8mp-tek.dts"
#include "imx8mp-android.dtsi"

/ {
	model = "[ANDROID] TechNexion TEK-IMX8MP board";

	wdt: watchdog{
	compatible = "linux,wdt-gpio";
	gpios = <&gpio1 8 GPIO_ACTIVE_HIGH>;
	hw_algo = "toggle";
	hw_margin_ms = <200>;
	always-running;
	};

	bt_rfkill {
		compatible = "fsl,mxc_bt_rfkill";
		//pinctrl-0 = <&pinctrl_bt_ctrl>;
		//bt-power-gpios = <&gpio1 3 GPIO_ACTIVE_LOW>;
		status ="okay";
	};

};
