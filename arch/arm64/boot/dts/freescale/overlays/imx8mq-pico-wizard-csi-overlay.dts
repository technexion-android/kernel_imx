/dts-v1/;
/plugin/;

#include "../imx8mq-pinfunc.h"
#include <dt-bindings/clock/imx8mq-clock.h>
#include <dt-bindings/interrupt-controller/irq.h>
#include <dt-bindings/input/input.h>
#include <dt-bindings/gpio/gpio.h>

/ {

	fragment@0 {
		target = <&csi1_bridge>;
		__overlay__ {
			status = "okay";
		};
	};

	fragment@1 {
		target = <&csi2_bridge>;
		__overlay__ {
			status = "okay";
		};
	};
};
