// SPDX-License-Identifier: (GPL-2.0+ OR MIT)
/*
 * Copyright 2020 Technexion Ltd.
 *
 * Author: Richard Hu <richard.hu@technexion.com>
 *
 */

/dts-v1/;

#include "imx8mp-axon-wizard.dts"
#include "imx8mp-android.dtsi"

/ {
	model = "[ANDROID] TechNexion AXON-IMX8MP with Wizard baseboard";
};

&lvds_backlight {
	brightness-levels = <0 255>;
	num-interpolated-steps = <100>;
	default-brightness-level = <41>;
};

&snvs_pwrkey {
	linux,keycode = <KEY_POWER>;
};
