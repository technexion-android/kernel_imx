// SPDX-License-Identifier: (GPL-2.0+ OR MIT)
/*
 * Copyright 2020 Technexion Ltd.
 *
 * Author: Richard Hu <richard.hu@technexion.com>
 *
 */

/dts-v1/;

#include "imx8mm-edm-g-wb.dts"
#include "imx8mm-android.dtsi"

/ {
	model = "[ANDROID] TechNexion EDM-G-IMX8MM with WB baseboard";
};

&lcdif {
	/delete-property/ trusty;
};
