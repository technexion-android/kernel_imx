// SPDX-License-Identifier: (GPL-2.0+ OR MIT)
/*
 * Copyright 2024 Technexion Ltd.
 *
 * Author: Tifa Chen <tifa.chen@technexion.com>
 *
 */

/dts-v1/;

#include "imx95-edm-evm.dts"

/ {
	model = "[ANDROID] TechNexion EDM-IMX95 and EVM baseboard";
};

&lpuart6 {
    /delete-node/ bluetooth;
};

&lvds0_backlight {
	brightness-levels = <0 255>;
	num-interpolated-steps = <100>;
	default-brightness-level = <41>;
	//	brightness-levels = <0 36 72 108 144 180 216 255>;
	//	default-brightness-level = <6>;
};

#include "imx95-android.dtsi"