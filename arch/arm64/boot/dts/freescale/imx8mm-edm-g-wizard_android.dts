// SPDX-License-Identifier: (GPL-2.0+ OR MIT)
/*
 * Copyright 2020 Technexion Ltd.
 *
 * Author: Richard Hu <richard.hu@technexion.com>
 *
 */

/dts-v1/;

#include "imx8mm-edm-g-wizard.dts"
#include "imx8mm-android.dtsi"
#include "tn_imx-android.dtsi"

/ {
	model = "[ANDROID] TechNexion EDM-G-IMX8MM with Wizard baseboard";
};

&lcdif {
	/delete-property/ trusty;
};

&vpu_v4l2 {
	status = "okay";
};
